/ {
	reserved-memory {
		#address-cells = <1>;
		#size-cells = <1>;
		ranges;
		linux,cma {
			// Increase shared CMA pool to 64MiB
			compatible = "shared-dma-pool";
			reusable;
			size = <0x4000000>;
			linux,cma-default;
		};
	};
};

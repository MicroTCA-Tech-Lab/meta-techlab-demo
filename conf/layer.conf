## conf/layer.conf
```bitbake
# We have a conf and classes directory, add to BBPATH
BBPATH .= ":${LAYERDIR}"

# We have recipes-* directories, add to BBFILES
BBFILES += "${LAYERDIR}/recipes-*/*/*.bb \
            ${LAYERDIR}/recipes-*/*/*.bbappend \
            ${LAYERDIR}/packagegroups/*.bb \
           "

BBFILE_COLLECTIONS += "meta-techlab-demo"
BBFILE_PATTERN_meta-techlab-demo = "^${LAYERDIR}/"
BBFILE_PRIORITY_meta-techlab-demo = "10"
LAYERDEPENDS_meta-techlab-demo = "core meta-techlab-bsp"
LAYERVERSION_meta-techlab-demo = "1"
LAYERSERIES_COMPAT_meta-techlab-demo = "zeus"
```
